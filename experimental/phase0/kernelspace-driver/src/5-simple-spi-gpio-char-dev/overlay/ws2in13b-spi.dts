/*
 * Device Tree overlay for epd module for raspberry-pi
 */

/dts-v1/;
/plugin/; /* allow undefined label references */

/ {
	compatible = "brcm,bcm2835", "bcrm,bcm2708";

    /* disable spidev */    
    fragment@0 {
        target = <&spidev0>;
        __overlay__ {
            status = "disabled";
        };
    };
        
	/* enable ws2in13b driver */
	fragment@1 {
		target = <&spi0>;
		__overlay__ {
            /* enable spi0, i think */
			status = "okay";

            /* needed to avoid dtc warning */
			#address-cells = <1>;
			#size-cells = <0>;
            
			ws2in13b: ws2in13b@0{
                /* enable this driver, i think */
                status = "okay";

				compatible = "ws2in13b";
				reg = <0>;
				#address-cells = <1>;
				#size-cells = <0>;
				spi-max-frequency = <1000000>;

				dc-gpios = <&gpio 25 0>;
				reset-gpios = <&gpio 17 0>;
				busy-gpios = <&gpio 24 0>;
			};
		};
	};
};